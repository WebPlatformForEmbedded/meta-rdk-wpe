## conf/layer.conf
```bitbake
# We have a conf and classes directory, add to BBPATH
BBPATH .= ":${LAYERDIR}"

# We have recipes-* directories, add to BBFILES
BBFILES += "${LAYERDIR}/recipes-*/*/*.bb \
    ${LAYERDIR}/recipes-*/*/*.bbappend"

BBFILE_COLLECTIONS += "rdk-wpe"
BBFILE_PATTERN_rdk-wpe = "^${LAYERDIR}/"
BBFILE_PRIORITY_rdk-wpe = "85"

#---------------------------------------------------------------------
# Distro specific settings that are needed for WPE
# Note: In the future these should be moved to a distro include file
#---------------------------------------------------------------------

# If we're building EGLFS
DISTRO_FEATURES_remove = "wayland"

# We're all opengl, drop directfb in effort to reduce image size.
#DISTRO_FEATURES_remove = "directfb"
#DISTRO_FEATURES_remove = "bluetooth"

# To enable DRM
#DISTRO_FEATURES_append = " opencdm playready provisioning"

# To enable Compositor
# DISTRO_FEATURES_append = " compositor"

# To enable Netflix (note you need to enable playready if the above DRM line is disabled)
#DISTRO_FEATURES_append = " netflix"

# Mask out some RDK-V stuff to ensure we're using upstream packages

BBMASK += "/meta-rdk-broadcom-generic-rdk/meta-brcm-generic-rdk/recipes-wpe/wpewebkit/wpewebkit_%.bbappend"
BBMASK += "/meta-cmf-raspberrypi/recipes-wpe/wpewebkit/wpewebkit_%.bbappend"
BBMASK += "/meta-rdk-broadcom-generic-rdk/meta-brcm-generic-rdk/recipes-wpe/wpebackend-rdk/wpebackend-rdk_0.1.bbappend"
BBMASK += "/meta-rdk/recipes-support/libsoup/libsoup-2.4*"

# drop OLD (very old) wpe recipes
BBMASK += '/meta-rdk-ext/recipes-extended/wpe*/*'

# Use meta-wpe gstreamer
BBMASK += '/meta-rdk-ext/recipes-multimedia/gstreamer/*'

# use meta-rdk-video westeros
BBMASK += '/meta-wpe/recipes-graphics/westeros/*'

# Mask out cairo changes, this breaks upsteam patches
BBMASK += '/meta-rdk-ext/recipes-graphics/cairo/*'
```
